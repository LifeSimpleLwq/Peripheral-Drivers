#include"LCD5110.h"
#include"delay.h"

/*********************************************************************************************************************************************
@f_name:void LCD5110_Init(void)
@brief :端口初始化以及液晶初始化
@param :   None
@return:   None
**********************************************************************************************************************************************/
void LCD5110_PortInit(void)
{
	GPIO_InitTypeDef  GPIO_InitStructure;
	
	RCC_APB2PeriphClockCmd(LCD5110_GPIOCLK , ENABLE);	 //使能PB端口时钟
	GPIO_PinRemapConfig(GPIO_Remap_SWJ_Disable,ENABLE);    //把调试设置普通IO口


	GPIO_InitStructure.GPIO_Pin = GPIO_Pin_DAT;				
	GPIO_InitStructure.GPIO_Mode = GPIO_Mode_Out_PP; 		 //推挽输出
	GPIO_InitStructure.GPIO_Speed = GPIO_Speed_50MHz;
	GPIO_Init(LCD5110_GPIO, &GPIO_InitStructure);
	GPIO_SetBits(LCD5110_GPIO ,GPIO_Pin_DAT);	
	
	LCD5110_Init();				

}
/*********************************************************************************************************************************************
@f_name:void LCD5110Wbyte(u8 dt, u8 command)
@brief :使用SPI接口写数据到LCD
@param :   command写数据/命令选择
@return:   None
**********************************************************************************************************************************************/
void LCD5110Wbyte(u8 dt, u8 command)
{
	u8 i; 
	LCD_CE(0);	
	LCD_DC(command);
	for(i=0;i<8;i++)
	{ 
		if(dt&0x80)
			LCD_DIN(1);
		else
			LCD_DIN(0);
		dt=dt<<1;		
		LCD_CLK(0);		
		LCD_CLK(1);
	}	
	LCD_DC(1);	
	LCD_CE(1);
	LCD_DIN(1);
}
/*********************************************************************************************************************************************
@f_name:void LCD5110SetPos(u8 x, u8 y)
@brief :设置LCD坐标函数
@param :   X：0－83  Y：0－5
@return:   None
**********************************************************************************************************************************************/
void LCD5110SetPos(u8 x, u8 y)
{
	LCD5110Wbyte(0x40|y, 0);// column
	LCD5110Wbyte(0x80|x, 0);// row
} 
/*********************************************************************************************************************************************
@f_name:void LCD5110Clear(void)
@brief :清屏
@param :   None
@return:   None
**********************************************************************************************************************************************/
void LCD5110Clear(void)
{
	u8 t;
	u8 k;
	LCD5110SetPos(0,0);
	for(t=0;t<6;t++)
	{ 
		for(k=0;k<84;k++)
		{ 
			LCD5110Wbyte(0x00,1);				
		} 
	}
}
///*********************************************************************************************************************************************
//@f_name:void LCD5110Clear(void)
//@brief :    显示6（宽）*16（高）点阵列数字字母符号等半角类
//@param :   None
//@return:   None
//**********************************************************************************************************************************************/
//void LCD5110WriteNum(u8 row, u8 page,u8 c) //row:列 page:页 dd:字符
//{
//	u8 i;
//	
//	LCD5110SetPos(row*6, page);// 列，页 
//	for(i=0; i<6;i++) 
//	{
//		LCD5110Wbyte(shuzi[c*12+i],1); 
//	}
//	
//    LCD5110SetPos(row*6, page+1);// 列，页 
//	for(i=6; i<12;i++) 
//	{
//		LCD5110Wbyte(shuzi[c*12+i],1);
//	}	 	
//}
///*********************************************************************************************************************************************
//@f_name:void LCD5110Clear(void)
//@brief :    显示6（宽）*16（高）点阵列数字字母符号等半角类
//@param :   None
//@return:   None
//*********************************************************************************************************************************************/
//void LCD_write_hanzi(u8 row, u8 page,u8 c) //row:列 page:页 dd:字符
//{
//	u8 i;  	
//	
//	LCD5110SetPos(row*6, page);// 列，页 
//	for(i=0; i<12;i++) 
//	{
//		LCD5110Wbyte(hanzi[c*24+i],1); 
//	}
//	
//    LCD5110SetPos(row*6, page+1);// 列，页 
//	for(i=12; i<24;i++) 
//	{
//		LCD5110Wbyte(hanzi[c*24+i],1);
//	}	
//}
/*********************************************************************************************************************************************
@f_name:void LCD5110_Init(void)
@brief :   液晶初始化
@param :   None
@return:   None
*********************************************************************************************************************************************/
void LCD5110_Init(void)
{
	LCD_RST(0);  	
  	delay_ms(10);
  	LCD_RST(1);  
	LCD5110Wbyte(0x21,0);//初始化Lcd,功能设定使用扩充指令
	LCD5110Wbyte(0xC6,0);//设定液晶偏置电压
	LCD5110Wbyte(0x06,0);//温度校正
  	LCD5110Wbyte(0x13,0);;//1:48
	LCD5110Wbyte(0x20,0);//使用基本指令
	LCD5110Wbyte(0x0C,0);//设定显示模式，正常显示
}

